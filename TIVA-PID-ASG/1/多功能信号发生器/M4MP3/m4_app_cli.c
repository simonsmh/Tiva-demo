#include <stdint.h>
#include <stdbool.h>
#include <stdarg.h>

#include "inc/hw_memmap.h"
#include "driverlib/rom.h"
#include "driverlib/adc.h"
#include "inc/hw_ints.h"
#include "driverlib/interrupt.h"
#include "driverlib/systick.h"
#include "driverlib/timer.h"

#include "FatFs/ff.h"

#include "m4_common.h"

#if defined(M4_RTX)
#include <rtl.h>
#elif defined(M4_FREERTOS)
#include "FreeRTOS.h"
#include "task.h"
#endif

#ifndef USE_GUI

#define DC_VOLTAGE          3.3
#define MAX_ADC_VALUE       0xFFF

#define MP3_FILE_NAME       "b1.wav"

#define KEY_INTERVAL_THRESHOLD      100     // ms, eliminate jitter


unsigned char fangbobuff1[]={0x00,0xFC,0x04,0x04,0x04,0x04,0x04,0xFC,0x00,0x00,0x00,0x00,0x00,0xFC,0x04,0x04,
							0x00,0xFF,0x00,0x00,0x00,0x00,0x00,0xFF,0x00,0x00,0x00,0x00,0x00,0xFF,0x00,0x00};

unsigned char fangbobuff2[]={0x04,0x04,0x04,0xFC,0x00,0x00,0x00,0x00,0x00,0xFC,0x04,0x04,0x04,0x04,0x04,0xFC,
							 0x00,0x00,0x00,0xFF,0x00,0x00,0x00,0x00,0x00,0xFF,0x00,0x00,0x00,0x00,0x00,0xFF};

unsigned char fangbobuff3[]={0x00,0x0F,0x00,0x00,0x00,0x00,0x00,0x0F,0x08,0x08,0x08,0x08,0x08,0x0F,0x00,0x00,
							 0x00,0x00,0x00,0x00,0x00,0x00,0x00,0x00,0x00,0x00,0x00,0x00,0x00,0x00,0x00,0x00};

unsigned char fangbobuff4[]= {0x00,0x00,0x00,0x0F,0x08,0x08,0x08,0x08,0x08,0x0F,0x00,0x00,0x00,0x00,0x00,0x0F,
							 0x00,0x00,0x00,0x00,0x00,0x00,0x00,0x00,0x00,0x00,0x00,0x00,0x00,0x00,0x00,0x00};

unsigned char sanjiaobuff1[]={0x00,0x00,0x00,0x00,0x80,0x40,0x20,0x10,0x20,0x40,0x80,0x00,0x00,0x00,0x00,0x00,
							  0x08,0x04,0x02,0x01,0x00,0x00,0x00,0x00,0x00,0x00,0x00,0x01,0x02,0x04,0x08,0x04};

unsigned char sanjiaobuff2[]={0x00,0x00,0x80,0x40,0x20,0x10,0x20,0x40,0x80,0x00,0x00,0x00,0x00,0x00,0x00,0x00,
							  0x02,0x01,0x00,0x00,0x00,0x00,0x00,0x00,0x00,0x01,0x02,0x04,0x08,0x10,0x08,0x04};

unsigned char juchibuff1[]={0x00,0x00,0x00,0x00,0x00,0x00,0x00,0x00,0x80,0x40,0x20,0x10,0xF8,0x00,0x00,0x00,
							0x80,0x40,0x20,0x10,0x08,0x04,0x02,0x01,0x00,0x00,0x00,0x00,0xFF,0x40,0x20,0x10};

unsigned char juchibuff2[]={0x00,0x00,0x00,0x00,0x80,0x40,0x20,0x10,0xF8,0x00,0x00,0x00,0x00,0x00,0x00,0x00,
							0x08,0x04,0x02,0x01,0x00,0x00,0x00,0x00,0xFF,0x40,0x20,0x10,0x08,0x04,0x02,0x01};

//unsigned char sinbuff1[]={};

//unsigned char sinbuff2[]={};
unsigned char sinbuff1[]={0x00,0x00,0x00,0x00,0x00,0x00,0x00,0x00,0x00,0x80,0xE0,0x30,0x0C,0x06,0x03,0x01,
						  0x00,0x00,0x00,0x00,0x00,0x00,0xC0,0x70,0x0E,0x01,0x00,0x00,0x00,0x00,0x00,0x00};

unsigned char sinbuff2[]={0x01,0x03,0x06,0x18,0x30,0xC0,0x00,0x00,0x00,0x00,0x00,0x00,0x00,0x00,0x00,0x00,
						 0x00,0x00,0x00,0x00,0x00,0x01,0x07,0x1C,0xE0,0x00,0x00,0x00,0x00,0x00,0x00,0x00};

unsigned char sinbuff3[]={0x00,0x00,0x00,0x00,0x00,0x00,0x00,0x00,0x07,0x38,0xE0,0x80,0x00,0x00,0x00,0x00,
						  0x00,0x00,0x00,0x00,0x00,0x00,0x00,0x00,0x00,0x00,0x00,0x03,0x0C,0x18,0x60,0xC0};

unsigned char sinbuff4[]={0x00,0x00,0x00,0x00,0x00,0x00,0x00,0x80,0x70,0x0E,0x03,0x00,0x00,0x00,0x00,0x00,
						 0x80,0x80,0xC0,0x60,0x30,0x0C,0x07,0x01,0x00,0x00,0x00,0x00,0x00,0x00,0x00,0x00} ;





//typedef enum __App_State_
//{
//    S_FIRST,
//    S_BUZZER = S_FIRST,
//    S_UART,
//    S_RECORD,
//    S_AUDIO,
//    S_LAST,
//} App_State;

typedef struct __App_Func_
{
    App_State state;
    char title[32];
    void (*func)(void);
} App_Func;

void app_demo       (void);
void app_temp       (void);  
void app_adc_pot    (void);
void app_adc_photo  (void);
void app_sawtoothwave   (void);
void app_triangularwave (void);
void app_squarewave (void);
void app_sinewave   (void);

App_Func dy_app[] = {
#if 1
    { S_BUZZER      , " 当前为锯齿波"
                    , app_sawtoothwave    },
    { S_UART        , " 当前为三角波"
                    , app_triangularwave      },
    { S_RECORD      , " 当前为方波"
                    , app_squarewave    },
    { S_AUDIO       , " 当前为正弦波"
                    , app_sinewave     },
#endif
};

App_State current_state;

void ani(uint8_t ms)
{
#define MAX_ANI     4
    char ani[] = { "\\-/|" };
    static uint8_t ani_index = 0;
    
    lcd_printf(15, 3, "%c", ani[ani_index++]);
    if (ani_index == MAX_ANI)
    {
        ani_index = 0;
    }
    if (ms > 0)
    {
        sleep(ms);
    }
}
void app_sawtoothwave(void)
{
	UC1701FontDisplay(2,0,16,16,juchibuff1);
	UC1701FontDisplay(2,2,16,16,juchibuff2);
//	UC1701FontDisplay(3,0,16,16,juchibuff3);
//	UC1701FontDisplay(3,2,16,16,juchibuff4);
	lcd_printf(6,6,"频率=1KHz");
	TimerLoadSet(TIMER0_BASE, TIMER_A, SysCtlClockGet()/20000);
    while (current_state == S_BUZZER)
    {
				//	dac_sawtoothwave();
    }
}

void app_triangularwave(void)
{
  	UC1701FontDisplay(2,0,16,16,sanjiaobuff1);
	UC1701FontDisplay(2,2,16,16,sanjiaobuff2);
	lcd_printf(6,6,"频率=1KHz");
 	TimerLoadSet(TIMER0_BASE, TIMER_A, SysCtlClockGet()/20000);
    while (current_state == S_UART)
    {
				//	dac_triangularwave();
	}
}

void app_squarewave(void)
{
	UC1701FontDisplay(2, 0, 16, 16,fangbobuff1);
   	UC1701FontDisplay(2, 2, 16, 16,fangbobuff2);
	UC1701FontDisplay(3, 0, 16, 16,fangbobuff3);
	UC1701FontDisplay(3, 2, 16, 16,fangbobuff4);
	lcd_printf(6,6,"频率=1KHz");
	TimerLoadSet(TIMER0_BASE, TIMER_A, SysCtlClockGet()/2000);
    while (current_state == S_RECORD)
    {
			//	dac_squarewave(); 
    }
}

void app_sinewave(void)
{
	 UC1701FontDisplay(2,0,16,16,sinbuff1);
	 UC1701FontDisplay(2,2,16,16,sinbuff2);
	 UC1701FontDisplay(3,2,16,16,sinbuff3);
	 UC1701FontDisplay(3,4,16,16,sinbuff4);
	 lcd_printf(6,6,"频率=500Hz");
	 TimerLoadSet(TIMER0_BASE, TIMER_A, SysCtlClockGet()/10000);
    while (current_state == S_AUDIO)
    {

			//	dac_sinewave();
       
    }
}

void uart_char_arrive(char ascii)
{
    if ((ascii >= ' ') && (ascii <= '~'))
    {
        lcd_printf(0, 2, "Got \"%c\"", ascii);
        m4_dbgprt("Got \"%c\"", ascii);
    }
}

void gpio_button_down(Button button)
{
    // filter out the "unstable" status
    static uint32_t last_key_down_tick;

#ifdef M4_FREERTOS
    sys_tick_count = xTaskGetTickCountFromISR();
#endif
    m4_dbgprt("t=%u\r\n", sys_tick_count);
    
    if ((sys_tick_count - last_key_down_tick) < KEY_INTERVAL_THRESHOLD)
    {
        m4_dbgprt("Jitter\r\n");
        return ;
    }
    last_key_down_tick = sys_tick_count;
    
    switch (button)
    {
        case Key_1:
            //break;
        case Key_2:
            // previous
            if (current_state == S_FIRST)
                current_state = S_LAST;
            current_state --;
            break;
        case Key_3:
            //break;
        case Key_4:
            // next
            current_state ++;
            if (current_state == S_LAST)
                current_state = S_FIRST;
    }
    
}

void app_main_cli(void)
{
    current_state = S_BUZZER;
#ifdef DEBUG
    //current_state = S_TEMP;
#endif
    
    uart_int_register(&uart_char_arrive);
    gpio_int_register(&gpio_button_down);
    
    while (1) 
    {
        lcd_clear();
        lcd_scroll(true);
        lcd_printf(0xFF, 0, dy_app[current_state].title);
        
        
        (*dy_app[current_state].func)();
        
        m4_dbgprt("%s\r\n", dy_app[current_state].title);
        
        // delay
        sleep(50);
    }
}
#endif // USE_GUI
